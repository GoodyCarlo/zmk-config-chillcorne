## boards/shields/ChillCorne/Kconfig.defconfig
```kconfig
if SHIELD_ChillCorne_DONGLE

# Max 16 characters in keyboard name
config ZMK_KEYBOARD_NAME
    default "ChillCorne"

config ZMK_SPLIT_ROLE_CENTRAL
    default y

config ZMK_SPLIT
    default y

endif
```

## boards/shields/ChillCorne/Kconfig.shield
```kconfig
# No whitespace after the comma or in the keyboard name!
config SHIELD_ChillCorne_DONGLE
    def_bool $(shields_list_contains,ChillCorne_dongle)
```
